/*
 * Copyright (c) 2026 Jorge Guzman
 *
 * SPDX-License-Identifier: Apache-2.0
 */

/*
 * TIMER1 is a 32-bit general timer, TIMER5 a 16-bit basic one. Both are
 * clocked at 90 MHz; slow the 16-bit one down so the periods the test uses
 * fit in its range.
 */
&timer1 {
	status = "okay";
};

&timer5 {
	status = "okay";
	prescaler = <8999>;
};
