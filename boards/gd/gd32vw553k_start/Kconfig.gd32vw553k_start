## boards/gd/gd32vw553k_start/Kconfig.gd32vw553k_start
```kconfig
# Copyright (c) 2026 Jorge Guzman
# SPDX-License-Identifier: Apache-2.0

config BOARD_GD32VW553K_START
	select SOC_GD32VW553
```

## boards/gd/gd32vw553k_start/board.yml
```yaml
board:
  name: gd32vw553k_start
  full_name: GD32VW553K-START
  vendor: gd
  socs:
    - name: gd32vw553
```

## boards/gd/gd_xd_w515_eval/Kconfig.gd_xd_w515_eval
```kconfig
# Copyright (c) 2026 Jorge Guzman
# SPDX-License-Identifier: Apache-2.0

config BOARD_GD_XD_W515_EVAL
	select SOC_GD32W515
```

## boards/gd/gd_xd_w515_eval/board.yml
```yaml
board:
  name: gd_xd_w515_eval
  full_name: GD-xD-W515-EVAL
  vendor: gd
  socs:
    - name: gd32w515
```

## drivers/audio/Kconfig.es8388
```kconfig
# Copyright (c) 2026 GZM
# SPDX-License-Identifier: Apache-2.0

config AUDIO_CODEC_ES8388
	bool "Everest Semiconductor ES8388 codec support"
	default y
	select I2C
	depends on DT_HAS_EVEREST_ES8388_ENABLED
	help
	  Enable support for the Everest Semiconductor ES8388, a stereo codec
	  with a DAC feeding two output pairs and a stereo ADC. Control is over
	  I2C; audio rides an I2S bus on which the codec is the slave.
```

## drivers/comparator/Kconfig.gd32_lvd
```kconfig
# Copyright (c) 2026 Jorge Guzman
# SPDX-License-Identifier: Apache-2.0

config COMPARATOR_GD32_LVD
	bool "GigaDevice GD32 low voltage detector"
	default y
	depends on DT_HAS_GD_GD32_LVD_ENABLED
	select GD32_EXTI
	help
	  Expose the low voltage detector (LVD) of GigaDevice GD32 SoCs
	  through the comparator API: the output is high while the supply is
	  below the programmed threshold, and crossing the threshold in either
	  direction can trigger a callback.
```

## drivers/crc/Kconfig.gd32
```kconfig
# Copyright (c) 2026 Jorge Guzman
# SPDX-License-Identifier: Apache-2.0

config CRC_GD32
	bool "GigaDevice GD32 CRC driver"
	default y
	depends on DT_HAS_GD_GD32_CRC_ENABLED
	select CRC_DRIVER_HAS_CRC32_IEEE
	select CRC_DRIVER_HAS_CRC32_MPEG2
	help
	  Enable the driver for the CRC calculation unit of GigaDevice GD32
	  SoCs. The unit implements the CRC-32 polynomial 0x04C11DB7 with a
	  fixed initial value, which covers CRC32_MPEG2 and CRC32_IEEE.
```

## drivers/crypto/Kconfig.gd32
```kconfig
# Copyright (c) 2026 Jorge Guzman
# SPDX-License-Identifier: Apache-2.0

config CRYPTO_GD32_CAU
	bool "GigaDevice GD32 CAU (AES) driver"
	default y
	depends on DT_HAS_GD_GD32_CAU_ENABLED
	select USE_GD32_CAU
	help
	  Enable the driver for the AES engine of the GD32 cryptographic
	  acceleration unit (ECB, CBC and CTR modes).

config CRYPTO_GD32_CAU_MAX_SESSIONS
	int "Maximum number of concurrent CAU sessions"
	depends on CRYPTO_GD32_CAU
	default 2

config CRYPTO_GD32_HAU
	bool "GigaDevice GD32 HAU (hash) driver"
	default y
	depends on DT_HAS_GD_GD32_HAU_ENABLED
	select USE_GD32_HAU
	help
	  Enable the driver for the GD32 hash acceleration unit (SHA-224 and
	  SHA-256).

config CRYPTO_GD32_HAU_MAX_SESSIONS
	int "Maximum number of concurrent HAU sessions"
	depends on CRYPTO_GD32_HAU
	default 2
```

## drivers/display/Kconfig.ili9881c
```kconfig
# Copyright (c) 2026 GZM
# SPDX-License-Identifier: Apache-2.0

config ILI9881C
	bool "ILI9881C MIPI-DSI display driver"
	default y
	depends on DT_HAS_ILITEK_ILI9881C_ENABLED
	select MIPI_DSI
	select GPIO if $(dt_compat_any_has_prop,$(DT_COMPAT_ILITEK_ILI9881C),reset-gpios) || \
		$(dt_compat_any_has_prop,$(DT_COMPAT_ILITEK_ILI9881C),bl-gpios)
	help
	  Enable driver for the Ilitek ILI9881C, a MIPI-DSI video mode panel
	  controller. The panel is driven in video mode, so the host streams
	  pixels continuously and this driver only carries the initialisation
	  sequence and the power/backlight control.

if ILI9881C

config DISPLAY_ILI9881C_INIT_PRIORITY
	int "Initialization priority"
	default MIPI_DSI_INIT_PRIORITY
	help
	  The panel attaches to the MIPI-DSI host, so it has to initialise after
	  that host and after the scanout controller streaming to it.

endif # ILI9881C
```

## drivers/flash/Kconfig.gd32_qspi
```kconfig
# Copyright (c) 2026 Jorge Guzman
# SPDX-License-Identifier: Apache-2.0

config FLASH_GD32_QSPI
	bool "GigaDevice GD32 QSPI NOR flash driver"
	default y
	depends on DT_HAS_GD_GD32_QSPI_NOR_ENABLED
	select FLASH_HAS_DRIVER_ENABLED
	select FLASH_HAS_PAGE_LAYOUT
	select FLASH_HAS_EXPLICIT_ERASE
	select FLASH_JESD216
	select PINCTRL
	select RESET
	help
	  Enable the driver of a NOR flash memory on the GD32 QSPI controller.

if FLASH_GD32_QSPI

config FLASH_GD32_QSPI_INIT_PRIORITY
	int "GD32 QSPI NOR flash init priority"
	default KERNEL_INIT_PRIORITY_DEVICE
	help
	  Device initialization priority of the GD32 QSPI NOR flash driver.

endif # FLASH_GD32_QSPI
```

## drivers/i2c/Kconfig.gd32
```kconfig
# Copyright (c) 2021 BrainCo Inc.
# SPDX-License-Identifier: Apache-2.0

config I2C_GD32
	bool "GigaDevice GD32 I2C driver"
	default y
	depends on DT_HAS_GD_GD32_I2C_ENABLED
	select PINCTRL
	help
	  Enables GigaDevice GD32 I2C driver (classic controller).

config I2C_GD32_V2
	bool "GigaDevice GD32 v2 I2C driver"
	default y
	depends on DT_HAS_GD_GD32_I2C_V2_ENABLED
	select PINCTRL
	help
	  Enables the GigaDevice GD32 "v2" I2C driver (TIMINGR/NBYTES/AUTOEND
	  controller, as found on the GD32VW55x).
```

## drivers/rtc/Kconfig.gd32
```kconfig
# Copyright (c) 2026 Jorge Guzman
# SPDX-License-Identifier: Apache-2.0

config RTC_GD32
	bool "GigaDevice GD32 RTC driver"
	default y
	depends on DT_HAS_GD_GD32_RTC_ENABLED
	select USE_GD32_PMU
	select USE_GD32_RCU
	select GD32_EXTI if RTC_ALARM
	help
	  Enable the driver for the calendar RTC of GigaDevice GD32 SoCs.
```

## drivers/video/Kconfig.esp32_csi
```kconfig
# Copyright (c) 2026 GZM
# SPDX-License-Identifier: Apache-2.0

config VIDEO_ESP32_CSI
	bool "ESP32-P4 MIPI-CSI-2 receiver"
	default y
	depends on DT_HAS_ESPRESSIF_ESP32_CSI_ENABLED
	help
	  Enable the MIPI-CSI-2 receiver on the ESP32-P4, which captures from a
	  camera sensor into memory.

if VIDEO_ESP32_CSI

config VIDEO_ESP32_CSI_INIT_PRIORITY
	int "Initialization priority"
	default 85
	help
	  After the sensor it reads from, which itself comes up after the IO
	  expander that usually powers it.

endif # VIDEO_ESP32_CSI
```

## drivers/video/Kconfig.sc202cs
```kconfig
# Copyright (c) 2026 GZM
# SPDX-License-Identifier: Apache-2.0

config VIDEO_SC202CS
	bool "SmartSens SC202CS image sensor"
	default y
	select I2C
	depends on DT_HAS_SMARTSENS_SC202CS_ENABLED
	help
	  Enable driver for the SmartSens SC202CS, a 2 MP MIPI-CSI-2 sensor
	  that outputs RAW Bayer over a single data lane.

if VIDEO_SC202CS

config VIDEO_SC202CS_INIT_PRIORITY
	int "Initialization priority"
	default 80
	help
	  Later than the IO expanders (70) on purpose: the enable line is
	  typically a pin on one of them, so this driver has to come up after the
	  expander and after the I2C controller carrying both.

endif # VIDEO_SC202CS
```

## drivers/wifi/gdwifi/Kconfig.gdwifi
```kconfig
# GigaDevice GD32VW55x Wi-Fi driver options

# Copyright (c) 2026 Jorge Guzman
# SPDX-License-Identifier: Apache-2.0

menuconfig WIFI_GDWIFI
	bool "GigaDevice GD32VW55x Wi-Fi (vendor SDK blobs)"
	default y
	depends on DT_HAS_GD_GD32VW55X_WIFI_ENABLED
	depends on SOC_SERIES_GD32VW55X
	select DYNAMIC_INTERRUPTS
	select DYNAMIC_THREAD
	select DYNAMIC_THREAD_ALLOC
	select THREAD_STACK_INFO
	select THREAD_MONITOR
	select THREAD_NAME
	select NET_L2_ETHERNET
	select WIFI_USE_NATIVE_NETWORKING
	select NET_SOCKETS
	select NET_DRIVERS
	select NET_LOOPBACK
	select NET_UDP
	select NET_IPV4
	select USE_GD32_ECLIC
	select USE_GD32_EFUSE
	select USE_GD32_FMC
	select USE_GD32_PMU
	select USE_GD32_TIMER
	select USE_GD32_CAU
	select USE_GD32_HAU
	select USE_GD32_PKCAU
	select USE_GD32_CRC
	select USE_GD32_TRNG
	select USE_GD32_EXTI
	select USE_GD32_SYSCFG
	select USE_GD32_DMA
	select USE_GD32_RTC
	help
	  Wi-Fi 6 driver for the GD32VW55x built on the GigaDevice
	  WiFi & BLE SDK: the MAC/PHY, RF and WPA libraries are prebuilt
	  BSD-3 blobs; wifi_manager and the platform layer are compiled
	  from the SDK sources.  The OS binding is gdwifi_os.c (sys_*
	  facade) and the network binding implements the SDK lwIP seam on
	  top of the Zephyr network stack.

if WIFI_GDWIFI

config WIFI_GDWIFI_SDK_PATH
	string "Path to a local GD32VW55x WiFi & BLE SDK checkout (optional)"
	default ""
	help
	  Leave empty (the default) to let the build fetch the OFFICIAL
	  GigaDevice SDK from GitHub at configure time, pinned to the
	  validated V1.0.3g commit, and apply the small source-only port
	  patch (same model as the Espressif esp-hal-3rdparty flow: no
	  binary ever enters the Zephyr tree; the BSD-3 blobs stay in the
	  vendor checkout under the west workspace).

	  Set a path only to use an existing local checkout; it must be
	  V1.0.3g (945c6e2) with the port patch applied (the hunks are
	  guarded by the GDWIFI_RTOS/GDWIFI_RTOS_NET defines).  The
	  prebuilt blobs are ABI-validated against this exact version.

config WIFI_GDWIFI_TRACE
	bool "Bring-up trace of the OS wrapper and radio init"
	help
	  Log task/mailbox activity of the sys_* facade and each radio
	  bring-up step.  Noisy: bring-up debugging only.

config HEAP_MEM_POOL_ADD_SIZE_GDWIFI
	int
	default 131072
	help
	  Radio stack heap contribution (sys_malloc runs on k_malloc).

config BT_GD32VW55X
	bool "GD32VW55x BLE controller (virtual HCI over the vendor blob)"
	# The PUBLIC V1.0.3g blobs ship without the HCI transport
	# (ble_register_hci_uart is a stub): this driver only works with a
	# libble built with CFG_VIRTUAL_HCI_MODE (partner deliverable).
	default n
	depends on DT_HAS_GD_GD32VW55X_BT_HCI_ENABLED
	depends on WIFI_GDWIFI
	depends on BT_HCI
	help
	  Drive the GD32VW55x BLE 5.3 controller (prebuilt libble) with the
	  native Zephyr Bluetooth host, through the SDK virtual HCI RAM
	  transport -- the same model as the Espressif VHCI driver.  The
	  radio platform is shared with (and brought up by) the Wi-Fi
	  driver, with coexistence handled inside the vendor blobs.

config WIFI_GDWIFI_TEST_AUTOCONNECT
	bool "TEST ONLY: auto-connect to a fixed AP at boot"
	help
	  Debug/validation helper: right after the radio bring-up the driver
	  connects to the SSID below (blocking) so Wi-Fi can be exercised
	  end-to-end without a serial console (flaky GD-Link VCP).  Never
	  enable in production images.

config WIFI_GDWIFI_TEST_SSID
	string "TEST ONLY: SSID"
	depends on WIFI_GDWIFI_TEST_AUTOCONNECT
	default ""

config WIFI_GDWIFI_TEST_PSK
	string "TEST ONLY: WPA2 passphrase"
	depends on WIFI_GDWIFI_TEST_AUTOCONNECT
	default ""

config GD32VW55X_BLE_VENDOR
	bool "GD32VW55x BLE advertising via the vendor host (no Zephyr BT host)"
	depends on WIFI_GDWIFI
	help
	  Start the RivieraWaves BLE host embedded in the prebuilt libble
	  (the only path the public GigaDevice blobs support: they carry no
	  HCI transport, so the native Zephyr Bluetooth host cannot drive
	  the controller).  Advertises a connectable device with the name
	  below; GAP/GATT belong to the vendor API (ble_adv_*, ble_gatts_*).

config GD32VW55X_BLE_VENDOR_NAME
	string "Advertised device name"
	default "ZephyrGD32"
	depends on GD32VW55X_BLE_VENDOR

endif # WIFI_GDWIFI
```

## dts/bindings/audio/everest,es8388.yaml
```yaml
# Copyright (c) 2026 GZM Embarcados
# SPDX-License-Identifier: Apache-2.0

description: |
  Everest Semiconductor ES8388 stereo audio codec.

  A low-power codec with a stereo DAC feeding two output pairs (LOUT1/ROUT1 and
  LOUT2/ROUT2) and a stereo ADC. Control is over I2C; audio rides an I2S bus on
  which the codec is the slave, so the SoC drives MCLK, BCLK and LRCK.

  On the M5Stack Tab5 both output pairs are wired and the speaker amplifier is
  gated by an IO expander pin, given here as spk-en-gpios.

compatible: "everest,es8388"

include: [i2c-device.yaml]

properties:
  spk-en-gpios:
    type: phandle-array
    description: |
      Speaker amplifier enable. Driven active when the output starts and
      inactive when it stops, so that the amplifier is not left powered - and
      not left passing the noise the codec makes while it is being set up.

  dac-output:
    type: string
    default: "both"
    enum: ["lout1-rout1", "lout2-rout2", "both"]
    description: |
      Which output pair the DAC is routed to. LOUT1/ROUT1 is usually the
      headphone amplifier and LOUT2/ROUT2 the loudspeaker one, but the two are
      interchangeable and boards wire them either way, so the default enables
      both rather than guessing.
```

## dts/bindings/bluetooth/gd,gd32vw55x-bt-hci.yaml
```yaml
# Copyright (c) 2026 Jorge Guzman
# SPDX-License-Identifier: Apache-2.0

description: GD32VW55x BLE 5.3 controller (virtual HCI over the vendor blob)

compatible: "gd,gd32vw55x-bt-hci"

include: bt-hci.yaml

properties:
  bt-hci-name:
    default: "GD32VW55x"
  bt-hci-bus:
    default: "virtual"
```

## dts/bindings/comparator/gd,gd32-lvd.yaml
```yaml
# Copyright (c) 2026 Jorge Guzman
# SPDX-License-Identifier: Apache-2.0

description: |
  GigaDevice GD32 low voltage detector (LVD).

  The LVD compares the VDD supply with a programmable threshold and drives
  EXTI line 16, which makes it a comparator with VDD on its positive input
  and the threshold on its negative one: the output is 1 while VDD is below
  the threshold, a rising edge means VDD just dropped below it and a falling
  edge means it recovered. The node covers the PMU register block, where the
  detector is configured.

  Example:

    &lvd {
        threshold-mv = <2700>;
        status = "okay";
    };

compatible: "gd,gd32-lvd"

include: base.yaml

properties:
  reg:
    required: true

  clocks:
    required: true
    description: The PMU clock.

  threshold-mv:
    type: int
    required: true
    enum:
      - 2100
      - 2300
      - 2400
      - 2600
      - 2700
      - 2900
      - 3000
      - 3100
    description: |
      Nominal detection threshold in millivolts. The detector has some
      hysteresis around it; the datasheet gives the exact rising and
      falling levels for each setting.
```

## dts/bindings/cpu/nuclei,n307.yaml
```yaml
# Copyright (c) 2026 Jorge Guzman
# SPDX-License-Identifier: Apache-2.0

description: Nuclei N307 RISC-V Core

compatible: "nuclei,n307"

include: riscv-common.yaml
```

## dts/bindings/crc/gd,gd32-crc.yaml
```yaml
# Copyright (c) 2026 Jorge Guzman
# SPDX-License-Identifier: Apache-2.0

description: |
  GigaDevice GD32 CRC calculation unit.

  The unit computes the CRC-32 with the fixed polynomial 0x04C11DB7 and
  initial value 0xFFFFFFFF over 32-bit words, without input or output
  reversal. The driver exposes it as CRC32_MPEG2 (native) and CRC32_IEEE
  (input and output reversed in software, the polynomial division in
  hardware).

compatible: "gd,gd32-crc"

include: [base.yaml, reset-device.yaml]

properties:
  reg:
    required: true

  clocks:
    required: true

  resets:
    required: true
```

## dts/bindings/crypto/gd,gd32-cau.yaml
```yaml
# Copyright (c) 2026 Jorge Guzman
# SPDX-License-Identifier: Apache-2.0

description: |
  GigaDevice GD32 cryptographic acceleration unit (CAU).

  The driver exposes the AES engine through the crypto API: ECB, CBC and
  CTR modes with 128, 192 and 256-bit keys, synchronous operations on
  separate input and output buffers.

compatible: "gd,gd32-cau"

include: [base.yaml, reset-device.yaml]

properties:
  reg:
    required: true

  clocks:
    required: true

  resets:
    required: true
```

## dts/bindings/crypto/gd,gd32-hau.yaml
```yaml
# Copyright (c) 2026 Jorge Guzman
# SPDX-License-Identifier: Apache-2.0

description: |
  GigaDevice GD32 hash acceleration unit (HAU).

  The driver exposes it through the crypto hash API for SHA-224 and
  SHA-256, computing a digest over one buffer per session.

compatible: "gd,gd32-hau"

include: [base.yaml, reset-device.yaml]

properties:
  reg:
    required: true

  clocks:
    required: true

  resets:
    required: true
```
