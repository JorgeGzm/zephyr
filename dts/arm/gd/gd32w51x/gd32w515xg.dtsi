/*
 * Copyright (c) 2026 Jorge Guzman
 *
 * SPDX-License-Identifier: Apache-2.0
 */

#include <mem.h>
#include <gd/gd32w51x/gd32w51x.dtsi>

/ {
	soc {
		sram0: memory@20000000 {
			reg = <0x20000000 DT_SIZE_K(384)>;
		};
	};
};

&flash0 {
	reg = <0x08000000 DT_SIZE_M(1)>;
	ranges = <0x0 0x08000000 DT_SIZE_M(1)>;
};
