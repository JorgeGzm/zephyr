## dts/bindings/flash_controller/gd,gd32-qspi-nor.yaml
```yaml
# Copyright (c) 2026 Jorge Guzman
# SPDX-License-Identifier: Apache-2.0

description: |
  NOR flash memory on the GigaDevice GD32 QSPI controller.

  The memory is driven in the indirect mode: single line commands, 4 KiB
  sector, 64 KiB block and chip erase. Reads (0x0b) and page programs
  (0x02) use one line too, unless quad-enable-requirements is set: the
  driver then sets the Quad Enable bit (S2B1v4, S2B1v5 and S2B1v6 are
  supported) and moves the data on four lines with the 1-1-4 read (0x6b)
  and page program (0x32) commands.

compatible: "gd,gd32-qspi-nor"

include: ["flash-controller.yaml", "jedec,jesd216.yaml"]

on-bus: qspi

properties:
  reg:
    required: true

  size:
    required: true
    description: Flash memory size in bits

  qspi-max-frequency:
    type: int
    required: true
    description: Maximum clock frequency of the memory in Hz
```

## dts/bindings/i2c/gd,gd32-i2c-v2.yaml
```yaml
# Copyright (c) 2026 Jorge Guzman
# SPDX-License-Identifier: Apache-2.0

description: |
  GigaDevice GD32 "v2" I2C controller (TIMINGR / NBYTES / AUTOEND, as found on
  the GD32VW55x). Distinct from "gd,gd32-i2c", which is the classic controller.

compatible: "gd,gd32-i2c-v2"

include: [i2c-controller.yaml, reset-device.yaml, pinctrl-device.yaml]

properties:
  reg:
    required: true

  resets:
    required: true

  clocks:
    required: true

  pinctrl-0:
    required: true

  pinctrl-names:
    required: true
```

## dts/bindings/qspi/gd,gd32-qspi.yaml
```yaml
# Copyright (c) 2026 Jorge Guzman
# SPDX-License-Identifier: Apache-2.0

description: |
  GigaDevice GD32 QSPI controller, for an external NOR flash memory.

compatible: "gd,gd32-qspi"

include: [base.yaml, pinctrl-device.yaml, reset-device.yaml]

bus: qspi

properties:
  reg:
    required: true

  clocks:
    required: true

  resets:
    required: true

  pinctrl-0:
    required: true

  pinctrl-names:
    required: true
```

## dts/bindings/rtc/gd,gd32-rtc.yaml
```yaml
# Copyright (c) 2026 Jorge Guzman
# SPDX-License-Identifier: Apache-2.0

description: |
  GigaDevice GD32 calendar RTC (BCD time and date registers, as found on
  the GD32VW55x series).

  The RTC lives in the backup domain and keeps counting across system
  resets for as long as that domain stays powered. The driver only
  programs the prescalers when the calendar has never been configured, so
  a time set before a reset survives it.

  Example:

    &rtc {
        status = "okay";
        clock-source = "lxtal";
    };

compatible: "gd,gd32-rtc"

include: rtc-device.yaml

properties:
  reg:
    required: true

  clocks:
    required: true
    description: |
      The PMU clock, which has to run to unlock the backup domain and
      reach the RTC registers.

  clock-source:
    type: string
    required: true
    enum:
      - "irc32k"
      - "lxtal"
    description: |
      Clock feeding the RTC: the internal 32 kHz RC oscillator (IRC32K) or
      the external 32.768 kHz crystal (LXTAL). LXTAL is far more accurate
      but needs a crystal on OSC32IN/OSC32OUT. The selection is latched by
      the backup domain, so it only takes effect the first time the RTC is
      enabled after a backup domain reset.

  async-prescaler:
    type: int
    description: |
      Asynchronous prescaler factor, 0 to 127. Defaults to 31 with IRC32K
      and 127 with LXTAL.

  sync-prescaler:
    type: int
    description: |
      Synchronous prescaler factor, 0 to 32767. Defaults to 999 with IRC32K
      and 255 with LXTAL. Together the prescalers must divide the clock
      source down to 1 Hz: (async + 1) * (sync + 1) = source frequency.
```

## dts/bindings/video/espressif,esp32-csi.yaml
```yaml
# Copyright (c) 2026 GZM
# SPDX-License-Identifier: Apache-2.0

description: |
  ESP32-P4 MIPI-CSI-2 receiver.

  Takes a CSI-2 stream from a camera sensor and hands the pixels to memory
  through the DW-GDMA. The receiver does not convert: what the sensor sends is
  what arrives, so a sensor emitting RAW Bayer produces RAW Bayer buffers.

  The D-PHY shares its 2.5 V rail with the DSI transmitter (internal LDO unit
  3), so on a board that already drives a MIPI panel the rail is up before this
  peripheral is touched.

compatible: "espressif,esp32-csi"

include: base.yaml

properties:
  sensor:
    type: phandle
    required: true
    description: The camera sensor feeding this receiver.

  data-lanes:
    type: int
    required: true
    enum: [1, 2]
    description: Number of CSI-2 data lanes wired between sensor and SoC.

  lane-rate-mbps:
    type: int
    required: true
    description: |
      Bit rate of one data lane, in Mbps, which the D-PHY PLL is programmed
      for. It comes from the sensor's mode, not from a free choice: a sensor
      sending faster or slower than this produces corrupt lines rather than an
      error.
```

## dts/bindings/video/smartsens,sc202cs.yaml
```yaml
# Copyright (c) 2026 GZM
# SPDX-License-Identifier: Apache-2.0

description: |
  SmartSens SC202CS 2 MP CMOS image sensor.

  Control is over SCCB, which is I2C with 16-bit register addresses. Pixels
  leave over MIPI-CSI-2 as RAW Bayer (BGGR), one data lane, so a receiver with
  an ISP has to demosaic them.

  The sensor takes its 24 MHz input clock from its own oscillator on the boards
  seen so far, which is why no clock property is defined here.

compatible: "smartsens,sc202cs"

include: i2c-device.yaml

properties:
  enable-gpios:
    type: phandle-array
    description: |
      Line that powers or enables the sensor, driven active during init. Often
      a pin on an IO expander rather than a SoC GPIO, in which case this driver
      must initialise after that expander.
```

## dts/bindings/wifi/gd,gd32vw55x-wifi.yaml
```yaml
# Copyright (c) 2026 Jorge Guzman
# SPDX-License-Identifier: Apache-2.0

description: GigaDevice GD32VW55x integrated Wi-Fi 6 MAC/PHY

compatible: "gd,gd32vw55x-wifi"

include: base.yaml

properties:
  reg:
    required: true
```

## soc/gd/gd32/gd32vw55x/Kconfig
```kconfig
# GD32VW55x SOC implementation

# Copyright (c) 2026 Jorge Guzman
# SPDX-License-Identifier: Apache-2.0

config SOC_SERIES_GD32VW55X
	select RISCV
	select RISCV_PRIVILEGED
	select RISCV_HAS_CLIC
	select RISCV_SOC_HAS_GP_RELATIVE_ADDRESSING
	select RISCV_SOC_CONTEXT_SAVE
	select INCLUDE_RESET_VECTOR
	select GD32_HAS_AF_PINMUX
	select GD32_HAS_IRC_32K
	select CPU_HAS_FPU
	select XIP
	select SOC_EARLY_INIT_HOOK
```

## soc/gd/gd32/gd32vw55x/Kconfig.defconfig.series
```kconfig
# Copyright (c) 2026 Jorge Guzman
# SPDX-License-Identifier: Apache-2.0

if SOC_SERIES_GD32VW55X

rsource "Kconfig.defconfig.gd32*"

endif # SOC_SERIES_GD32VW55X
```

## soc/gd/gd32/gd32vw55x/Kconfig.soc
```kconfig
# GD32VW55x SOC configuration options

# Copyright (c) 2026 Jorge Guzman
# SPDX-License-Identifier: Apache-2.0

config SOC_SERIES_GD32VW55X
	bool
	select SOC_FAMILY_GD_GD32
	help
	  Enable support for GigaDevice GD32VW55x MCU series

config SOC_SERIES
	default "gd32vw55x" if SOC_SERIES_GD32VW55X

config SOC_GD32VW553
	bool
	select SOC_SERIES_GD32VW55X

config SOC
	default "gd32vw553" if SOC_GD32VW553
```

## soc/gd/gd32/gd32w51x/Kconfig
```kconfig
# GD32W51x SOC implementation

# Copyright (c) 2026 Jorge Guzman
# SPDX-License-Identifier: Apache-2.0

config SOC_SERIES_GD32W51X
	select ARM
	select CPU_CORTEX_M33
	select CPU_HAS_ARM_MPU
	select CPU_HAS_ARM_SAU
	select CPU_HAS_FPU
	select ARMV8_M_DSP
	select ARMV8_M_SE
	select GD32_HAS_AF_PINMUX
	select GD32_HAS_IRC_32K
	select SOC_EARLY_INIT_HOOK
```

## soc/gd/gd32/gd32w51x/Kconfig.defconfig.series
```kconfig
# Copyright (c) 2026 Jorge Guzman
# SPDX-License-Identifier: Apache-2.0

if SOC_SERIES_GD32W51X

rsource "Kconfig.defconfig.gd32*"

endif # SOC_SERIES_GD32W51X
```

## soc/gd/gd32/gd32w51x/Kconfig.soc
```kconfig
# GD32W51x SOC configuration options

# Copyright (c) 2026 Jorge Guzman
# SPDX-License-Identifier: Apache-2.0

config SOC_SERIES_GD32W51X
	bool
	select SOC_FAMILY_GD_GD32
	help
	  Enable support for GigaDevice GD32W51x MCU series

config SOC_SERIES
	default "gd32w51x" if SOC_SERIES_GD32W51X

config SOC_GD32W515
	bool
	select SOC_SERIES_GD32W51X

config SOC
	default "gd32w515" if SOC_GD32W515
```
